
#include <stdlib.h>
#include <SPI.h>
#include <Wire.h>
#include <Adafruit_GFX.h>
#include <Adafruit_SSD1306.h>

#define SCREEN_WIDTH 128 // OLED display width, in pixels
#define SCREEN_HEIGHT 64 // OLED display height, in pixels

// Declaration for an SSD1306 display connected to I2C (SDA, SCL pins)
#define OLED_RESET     -1 // Reset pin # (or -1 if sharing Arduino reset pin)
Adafruit_SSD1306 display(SCREEN_WIDTH, SCREEN_HEIGHT, &Wire, OLED_RESET);

// 'BaslaBos', 64x32px
const unsigned char epd_bitmap_BaslaBos [] PROGMEM = {
	0x00, 0x00, 0x00, 0x00, 0x00, 0x00, 0x00, 0x00, 0x00, 0x00, 0x00, 0x00, 0x00, 0x00, 0x00, 0x00, 
	0x00, 0x00, 0x00, 0x00, 0x00, 0x00, 0x00, 0x00, 0x00, 0x00, 0x00, 0x00, 0x00, 0x00, 0x00, 0x00, 
	0x00, 0x00, 0x00, 0x00, 0x00, 0x00, 0x00, 0x00, 0x00, 0x00, 0x00, 0x00, 0x00, 0x00, 0x00, 0x00, 
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	0x00, 0x00, 0x00, 0x00, 0x00, 0x00, 0x00, 0x00, 0x00, 0x00, 0x00, 0x00, 0x00, 0x00, 0x00, 0x00
};
// 'BaslaSecildi', 64x32px
const unsigned char epd_bitmap_BaslaSecildi [] PROGMEM = {
	0xff, 0xff, 0xff, 0xff, 0xff, 0xff, 0xff, 0xff, 0xff, 0xff, 0xff, 0xff, 0xff, 0xff, 0xff, 0xff, 
	0xff, 0xff, 0xff, 0xff, 0xff, 0xff, 0xff, 0xff, 0xff, 0xff, 0xff, 0xff, 0xff, 0xff, 0xff, 0xff, 
	0xff, 0xff, 0xff, 0xff, 0xff, 0xff, 0xff, 0xff, 0xff, 0xff, 0xff, 0xff, 0xff, 0xff, 0xff, 0xff, 
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	0xff, 0xff, 0xff, 0xff, 0xff, 0xff, 0xff, 0xff, 0xff, 0xff, 0xff, 0xff, 0xff, 0xff, 0xff, 0xff
};
// 'ZorlukBos', 64x32px
const unsigned char epd_bitmap_ZorlukBos [] PROGMEM = {
	0x00, 0x00, 0x00, 0x00, 0x00, 0x00, 0x00, 0x00, 0x00, 0x00, 0x00, 0x00, 0x00, 0x00, 0x00, 0x00, 
	0x00, 0x00, 0x00, 0x00, 0x00, 0x00, 0x00, 0x00, 0x00, 0x00, 0x00, 0x00, 0x00, 0x00, 0x00, 0x00, 
	0x00, 0x00, 0x00, 0x00, 0x00, 0x00, 0x00, 0x00, 0x00, 0x00, 0x00, 0x00, 0x00, 0x00, 0x00, 0x00, 
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	0x00, 0x00, 0x00, 0x00, 0x00, 0x00, 0x00, 0x00, 0x00, 0x00, 0x00, 0x00, 0x00, 0x00, 0x00, 0x00
};
// 'ZorlukSecildi', 64x32px
const unsigned char epd_bitmap_ZorlukSecildi [] PROGMEM = {
	0xff, 0xff, 0xff, 0xff, 0xff, 0xff, 0xff, 0xff, 0xff, 0xff, 0xff, 0xff, 0xff, 0xff, 0xff, 0xff, 
	0xff, 0xff, 0xff, 0xff, 0xff, 0xff, 0xff, 0xff, 0xff, 0xff, 0xff, 0xff, 0xff, 0xff, 0xff, 0xff, 
	0xff, 0xff, 0xff, 0xff, 0xff, 0xff, 0xff, 0xff, 0xff, 0xff, 0xff, 0xff, 0xff, 0xff, 0xff, 0xff, 
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	0xff, 0xff, 0xff, 0xff, 0xff, 0xff, 0xff, 0xff, 0xff, 0xff, 0xff, 0xff, 0xff, 0xff, 0xff, 0xff
};

// 'altTasarim', 64x32px
const unsigned char epd_bitmap_altTasarim [] PROGMEM = {
	0x00, 0x00, 0x00, 0x00, 0x00, 0x00, 0x00, 0x00, 0x00, 0x02, 0x00, 0x00, 0x00, 0x00, 0x04, 0x00, 
	0x01, 0x00, 0x10, 0x00, 0x00, 0x00, 0x00, 0x00, 0x00, 0x00, 0x38, 0x01, 0x80, 0x20, 0x00, 0x00, 
	0x08, 0x80, 0x10, 0x02, 0x40, 0x00, 0x00, 0x04, 0x00, 0x80, 0x00, 0x04, 0x20, 0x00, 0x04, 0x00, 
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	0x00, 0x00, 0x17, 0x83, 0x81, 0xf8, 0x40, 0x08, 0x00, 0x00, 0x00, 0x00, 0x00, 0x00, 0x00, 0x00
};

// 'ustTasarim', 64x32px
const unsigned char epd_bitmap_ustTasarim [] PROGMEM = {
	0x00, 0x00, 0x00, 0x00, 0x00, 0x00, 0x00, 0x00, 0x00, 0x00, 0x00, 0x00, 0x00, 0x00, 0x00, 0x00, 
	0x00, 0x00, 0x00, 0x00, 0x00, 0x00, 0x00, 0x00, 0x00, 0x00, 0x00, 0x00, 0x00, 0x00, 0x00, 0x00, 
	0x00, 0x00, 0x00, 0x00, 0x00, 0x00, 0x00, 0x00, 0x00, 0x00, 0x00, 0x00, 0x00, 0x00, 0x00, 0x00, 
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	0x00, 0x00, 0x00, 0x00, 0x00, 0x00, 0x00, 0x00, 0x00, 0x00, 0x00, 0x00, 0x00, 0x00, 0x00, 0x00
};

// Array of all bitmaps for convenience. (Total bytes used to store images in PROGMEM = 1088)
//const int epd_bitmap_allArray_LEN = 6;
const unsigned char* baslangicIcons[6] = {
	epd_bitmap_BaslaBos,
	epd_bitmap_BaslaSecildi,
	epd_bitmap_ZorlukBos,
	epd_bitmap_ZorlukSecildi,
  epd_bitmap_altTasarim,
  epd_bitmap_ustTasarim
};

// 'seviye1Bos', 64x64px
const unsigned char epd_bitmap_seviye1Bos [] PROGMEM = {
	0x00, 0x00, 0x00, 0x00, 0x00, 0x00, 0x00, 0x00, 0x00, 0x00, 0x00, 0x00, 0x00, 0x00, 0x00, 0x00, 
	0x00, 0x00, 0x00, 0x00, 0x00, 0x00, 0x00, 0x00, 0x00, 0x00, 0x00, 0x00, 0x00, 0x00, 0x00, 0x00, 
	0x00, 0x00, 0x00, 0x00, 0x00, 0x00, 0x00, 0x00, 0x00, 0x00, 0x00, 0x00, 0x00, 0x00, 0x00, 0x00, 
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	0x00, 0x00, 0x00, 0x00, 0x00, 0x00, 0x00, 0x00, 0x00, 0x00, 0x00, 0x00, 0x00, 0x00, 0x00, 0x00
};
// 'seviye1Secildi', 64x64px
const unsigned char epd_bitmap_seviye1Secildi [] PROGMEM = {
	0xff, 0xff, 0xff, 0xff, 0xff, 0xff, 0xff, 0xff, 0xff, 0xff, 0xff, 0xff, 0xff, 0xff, 0xff, 0xff, 
	0xff, 0xff, 0xff, 0xff, 0xff, 0xff, 0xff, 0xff, 0xff, 0xff, 0xff, 0xff, 0xff, 0xff, 0xff, 0xff, 
	0xff, 0xff, 0xff, 0xff, 0xff, 0xff, 0xff, 0xff, 0xff, 0xff, 0xff, 0xff, 0xff, 0xff, 0xff, 0xff, 
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	0xff, 0xff, 0xff, 0xff, 0xff, 0xff, 0xff, 0xff, 0xff, 0xff, 0xff, 0xff, 0xff, 0xff, 0xff, 0xff
};
// 'seviye2Bos', 64x64px
const unsigned char epd_bitmap_seviye2Bos [] PROGMEM = {
	0x00, 0x00, 0x00, 0x00, 0x00, 0x00, 0x00, 0x00, 0x00, 0x00, 0x00, 0x00, 0x00, 0x00, 0x00, 0x00, 
	0x00, 0x00, 0x00, 0x00, 0x00, 0x00, 0x00, 0x00, 0x00, 0x00, 0x00, 0x00, 0x00, 0x00, 0x00, 0x00, 
	0x00, 0x00, 0x00, 0x00, 0x00, 0x00, 0x00, 0x00, 0x00, 0x00, 0x00, 0x00, 0x00, 0x00, 0x00, 0x00, 
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	0x00, 0x00, 0x00, 0x00, 0x00, 0x00, 0x00, 0x00, 0x00, 0x00, 0x00, 0x00, 0x00, 0x00, 0x00, 0x00
};
// 'seviye2Secildi', 64x64px
const unsigned char epd_bitmap_seviye2Secildi [] PROGMEM = {
	0xff, 0xff, 0xff, 0xff, 0xff, 0xff, 0xff, 0xff, 0xff, 0xff, 0xff, 0xff, 0xff, 0xff, 0xff, 0xff, 
	0xff, 0xff, 0xff, 0xff, 0xff, 0xff, 0xff, 0xff, 0xff, 0xff, 0xff, 0xff, 0xff, 0xff, 0xff, 0xff, 
	0xff, 0xff, 0xff, 0xff, 0xff, 0xff, 0xff, 0xff, 0xff, 0xff, 0xff, 0xff, 0xff, 0xff, 0xff, 0xff, 
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	0xff, 0xff, 0xff, 0xff, 0xff, 0xff, 0xff, 0xff, 0xff, 0xff, 0xff, 0xff, 0xff, 0xff, 0xff, 0xff
};

// Array of all bitmaps for convenience. (Total bytes used to store images in PROGMEM = 2112)
//const int epd_bitmap_allArray_LEN = 4;
const unsigned char* zorlukIcons[4] = {
	epd_bitmap_seviye1Bos,
	epd_bitmap_seviye1Secildi,
	epd_bitmap_seviye2Bos,
	epd_bitmap_seviye2Secildi
};

// 'can', 8x8px
const unsigned char epd_bitmap_can [] PROGMEM = {
	0x00, 0x00, 0x02, 0x26, 0x72, 0x22, 0x00, 0x00
};
// 'dokunulmazlik', 8x8px
const unsigned char epd_bitmap_dokunulmazlik [] PROGMEM = {
	0x00, 0x00, 0x38, 0x24, 0x24, 0x38, 0x00, 0x00
};
// 'meteor', 8x8px
const unsigned char epd_bitmap_meteor [] PROGMEM = {
	0x00, 0x3c, 0x72, 0x7a, 0x7e, 0x5e, 0x3c, 0x00
};
// 'silah', 8x8px
const unsigned char epd_bitmap_silah [] PROGMEM = {
	0x00, 0x41, 0xfa, 0xe1, 0xa0, 0x80, 0x00, 0x00
};

// 'bosluk', 8x8px
const unsigned char epd_bitmap_bosluk [] PROGMEM = {
	0x00, 0x00, 0x00, 0x00, 0x00, 0x00, 0x00, 0x00
};

// 'roket', 8x8px
const unsigned char epd_bitmap_roket [] PROGMEM = {
	0x18, 0x99, 0xbd, 0xff, 0xbd, 0x24, 0x24, 0x81
};

// 'meteor2', 8x8px
const unsigned char epd_bitmap_meteor2 [] PROGMEM = {
	0xff, 0xc3, 0x8d, 0x85, 0x81, 0xa1, 0xc3, 0xff
};

// Array of all bitmaps for convenience. (Total bytes used to store images in PROGMEM = 128)
//const int epd_bitmap_allArray_LEN = 4;
const unsigned char* oyunIcons[7] = {
	epd_bitmap_can,
	epd_bitmap_silah,
	epd_bitmap_dokunulmazlik,
	epd_bitmap_meteor,
	epd_bitmap_bosluk, 
	epd_bitmap_roket,
	epd_bitmap_meteor2
};

volatile boolean baslangic_ekrani, zorluk_ekrani, seviye1, seviye2;
volatile boolean zorluk_secildi, oyun_ekrani, dokunulmazlikAlindi, skorBaslat;

int temp = 0, x = 0, y = 0, tmp = 0;
int sag_basildi, sol_basildi, ok_basildi, ates_basildi;
int sag_cekildi, sol_cekildi, ok_cekildi, ates_cekildi;

//const unsigned char* ekran[16][8];
int ekranKontrol[16][8]; //Bu oyun içerisineki isterler için var.
int items[16][4];
int satir = 0, simdikiZaman = 0, oncekiZaman = 0, oncekiZamanDokunulmazlik = 0;
int roket_x = 0, roket_y = 0, frame_suresi = 1000, platformSaniye = 0;
int kursun_x = 0, kursun_y = 0, dokunulmazlikSaniye = 0, isikMiktari = 0;
int kursunSayisi = 3, canSayisi = 3, meteorSayisi = 0, score = 0;

int birler_a = 27;
int birler_b = 26;
int birler_c = 23;
int birler_d = 24;
int birler_e = 25;
int birler_f = 28;
int birler_g = 29;

void setup() {
	Serial.begin(9600);

	//tekrar ana menu acildigi zaman oyunun sıfırdan baslamasi icin degiskenler sifirlandi.

	restart();

  pinMode(49, INPUT); // sağ veya yukarı
  pinMode(51, INPUT); // ok   
  pinMode(53, INPUT); // sol veya aşağı

	pinMode(47, INPUT); // ates

  pinMode(8, OUTPUT);
  pinMode(9, OUTPUT);
  pinMode(10, OUTPUT);

  pinMode(11, OUTPUT);
  pinMode(12, OUTPUT);
  pinMode(13, OUTPUT);

  // SSD1306_SWITCHCAPVCC = generate display voltage from 3.3V internally
  if(!display.begin(SSD1306_SWITCHCAPVCC, 0x3C)) { 
    Serial.println(F("SSD1306 allocation failed"));
    for(;;); // Don't proceed, loop forever
  }

  display.setRotation(3); // 90 derece döndü

  display.clearDisplay();
}

void loop() {

		isikMiktari = map(analogRead(A6), 0, 1023, 0, 100);

		if(isikMiktari < 50) display.invertDisplay(false);
		else display.invertDisplay(true);

    sol();
    sag();
    sec();

    if(baslangic_ekrani) baslangicEkrani();
    if(zorluk_ekrani) zorlukEkrani();
    if(oyun_ekrani) oyunEkrani();
}

void butonSifirla(){
	sag_basildi = sag_cekildi = 0;
	sol_basildi = sol_cekildi = 0;
	ates_basildi = ates_cekildi = 0;
  ok_basildi = ok_cekildi = 0;
}

void restart(){

	if(oyun_ekrani){
		tone(7,5);
		delay(500);
		tone(7,10);
		delay(500);
		tone(7,5);
		delay(500);
	}

	noTone(7);

	butonSifirla();

	baslangic_ekrani = true;
	zorluk_ekrani = false;
	oyun_ekrani = false;

	dokunulmazlikAlindi = zorluk_secildi = false;
	seviye1 = seviye2 = skorBaslat = false;

	y = 0, satir = 0, meteorSayisi = score = 0;
	//simdikiZaman = oncekiZaman = oncekiZamanDokunulmazlik = 0;
	platformSaniye = dokunulmazlikSaniye = 0;
	kursunSayisi = canSayisi = 3;
	frame_suresi = 1000;

	for(int i = 0; i < 16; i++)
		for(int j = 0; j < 8; j++){
			ekranKontrol[i][j] = 4;
			items[i][j/2] = 4;
		}
	
		
}

void sec(){

  if(digitalRead(51)){
    ok_basildi = 1;
  }
  
  if(!digitalRead(51) && ok_basildi == 1){
    ok_cekildi = 1;
  }

  if(ok_basildi == 1 && ok_cekildi == 1 && y == 0 && baslangic_ekrani){
    butonSifirla();
    baslangic_ekrani = false;
    zorluk_ekrani = true;
  }

  if(ok_basildi == 1 && ok_cekildi == 1 && y == 1 && baslangic_ekrani && zorluk_secildi){
    butonSifirla();
    baslangic_ekrani = false;
    zorluk_ekrani = false;
    oyun_ekrani = true;
  }

  if(ok_basildi == 1 && ok_cekildi == 1 && zorluk_ekrani){

		butonSifirla();

    if(y == 0){
      seviye1 = true;
      seviye2 = false;
      y = 0; // baslangic ekranında üstte olması icin
      zorluk_secildi = true;
    }

    if(y == 1){
      seviye1 = false;
      seviye2 = true;
      y = 0;
      zorluk_secildi = true;
    }

    baslangic_ekrani = true;
    zorluk_ekrani = false;
  }
}

void sol(){

  if(digitalRead(49)){
    sol_basildi = 1;
  }

  if(!digitalRead(49) && sol_basildi == 1){
    sol_cekildi = 1;
  }  

  if(sol_basildi == 1 && sol_cekildi == 1){
    y = 0;
		butonSifirla();
	}

}

void sag(){

  if(digitalRead(53)){
    sag_basildi = 1;
  }

  if(!digitalRead(53) && sag_basildi == 1){
    sag_cekildi = 1;
  }

  if(sag_basildi == 1 && sag_cekildi == 1){
    y = 1;
		butonSifirla();
	}

}

void ates(){

	if(digitalRead(47)){
		ates_basildi = 1;
  }

  if(!digitalRead(47) && ates_basildi == 1){
		ates_cekildi = 1;
  }
	
	if(ates_basildi == 1 && ates_cekildi == 1){
		if(kursunSayisi != 0) kursunAt();
		butonSifirla();
	}

}

void kursunAt(){

	kursun_x = roket_x/8;
	kursun_y = 15;
	kursunSayisi-=1;

	for(int i = 15; i >= 0; i--){

		if(ekranKontrol[i][kursun_x] == 3){ // 3 veya 6 (vurulmus) -> meteor
			ekranKontrol[i][kursun_x] = 6;
			break;
		}

		else if(ekranKontrol[i][kursun_x] == 6){
			ekranKontrol[i][kursun_x] = 4; // vurulunca bosluk oluyor.
			break;
		}
	}

}

void upToDown(){

	for (int i = 15; i > 0; i--) // Bir ust satir alta kopyalanıyor
    for (int j = 0; j < 8; j++){
			ekranKontrol[i][j] = ekranKontrol[i-1][j];
		}

	if(satir % 16 == 0){

    satir = 0;

		for(int i = 0; i < 16; i++)
			for(int j = 0; j < 4; j++){
				items[i][j] = 4;
			}

    for(int i = 0; i < 16; i++) // 0 -> can , 1 -> silah
      for(int j = 0; j < 4; j++){
				
				/*if(items[i][j] == 1)
					meteorSayisi = 0;*/

				meteorSayisi *= (items[i][j] == 1) ? 0 : 1;

				if(items[i][j] == 4){
					items[i][j] = random(2,4); // 2 veya 3 gelmesi lazim.				
				}

				meteorSayisi += (items[i][j] == 3) ? 1 : 0;

				if(meteorSayisi == 14){
					items[i+1][1] = 0;
					items[i+1][2] = 1;
					meteorSayisi += 1; //ustteki silaha kadar gelen meteorlar sayilmasin diye
				}				
			}

  }

  for (int i = 0; i < 8; i++){ //ekranin en ustunde yeni itemler geldi.
		if(i % 2 == 0){
			tmp = items[satir][i/2];
			ekranKontrol[0][i] = tmp;
		}
		else
			ekranKontrol[0][i] = 4;
	}

	for(int i = 0; i < 16; i++)
    for(int j = 0; j < 8; j++){
			temp = ekranKontrol[i][j];
			display.drawBitmap(j*8, i*8, oyunIcons[temp], 8, 8, WHITE);    
    }
               
  satir++;

	if(satir == 16) skorBaslat = true;
}

void oyunEkrani(){

	for(int i = 0; i < kursunSayisi; i++){
		if(i == 0){
			digitalWrite(8, HIGH);
			digitalWrite(9, LOW);
			digitalWrite(10, LOW);
		}

		if(i == 1){
			digitalWrite(9, HIGH);
			digitalWrite(10, LOW);
		}

		if(i == 2) digitalWrite(10, HIGH);
	}

	if(kursunSayisi == 0){
		digitalWrite(8, LOW);
		digitalWrite(9, LOW);
		digitalWrite(10, LOW);
	}

	for(int i = 0; i < canSayisi; i++){
		if(i == 0){
			digitalWrite(11, HIGH);
			digitalWrite(12, LOW);
			digitalWrite(13, LOW);
		}

		if(i == 1){
			digitalWrite(12, HIGH);
			digitalWrite(13, LOW);
		}

		if(i == 2) digitalWrite(13, HIGH);
	}

	if(canSayisi == 0){ // oyun burada yeniden ana menuye donuyor
		digitalWrite(11, LOW);
		digitalWrite(12, LOW);
		digitalWrite(13, LOW);

		digitalWrite(8, LOW);
		digitalWrite(9, LOW);
		digitalWrite(10, LOW);

		restart();
	}

	ates();

  // can ve silah hakları olan ledler yandi.

	//roket_x = (analogRead(A7)/146)*8;
	roket_x = map(analogRead(A7), 0, 1023, 0, 7)*8;
	roket_y = 120;

	display.drawBitmap(roket_x, roket_y, oyunIcons[5], 8, 8, WHITE);		      

  simdikiZaman = millis();

	if(simdikiZaman - oncekiZamanDokunulmazlik >= 1000){
		dokunulmazlikSaniye +=1;
		oncekiZamanDokunulmazlik = simdikiZaman;
	}

	if(dokunulmazlikSaniye == 3){
		//dokunulmazlikSaniye = 0;
		dokunulmazlikAlindi = false;
	}

	if(simdikiZaman - oncekiZaman >= frame_suresi){ //frame suresi en basta 1000 ms.

		upToDown();
		oncekiZaman = simdikiZaman;

		score += (skorBaslat) ? 1 : 0;

		showScore(score % 10, 0); //Birler Basamagi
		showScore((score/10) % 10, 1); //Onlar Basamagi
		showScore(score/100, 2); //Yuzler Basamagi

		platformSaniye+=1; // seviye2 secildiyse her 10 saniyede %20 hizlaniyor.

		if(platformSaniye == 10 && seviye2){
			frame_suresi -= frame_suresi/5;
			platformSaniye = 0;
		}
	}

	for(int i = 0; i < 16; i++)
    for(int j = 0; j < 8; j++){
			temp = ekranKontrol[i][j];
			display.drawBitmap(j*8, i*8, oyunIcons[temp], 8, 8, WHITE);      
    }

	switch(ekranKontrol[15][roket_x/8]){
		case 0: // Odul Puani (Can)
			canSayisi += (canSayisi < 3) ? 1 : 0;
			break;

		case 1:
			kursunSayisi += (kursunSayisi < 3) ? 1 : 0;
			break;

		case 2:
			dokunulmazlikAlindi = true;
			dokunulmazlikSaniye = 0;
			break;

		case 3: // meteor
		case 6: // Hasar almis meteor
			if(!dokunulmazlikAlindi)
				canSayisi -= 1;

			dokunulmazlikAlindi = true;
			dokunulmazlikSaniye = 0;
								
			tone(7,5);
			break;

		case 4:
			noTone(7);
			break;
	}

	ekranKontrol[15][roket_x/8] = 4; //loop icerisinde alinan item tekrar alinmasin diye.

  display.display();
  display.clearDisplay();
}

void zorlukEkrani() {

  if(y == 0){
    display.drawBitmap(0, 0, zorlukIcons[1], 64, 64, WHITE);
    display.drawBitmap(0, 64, zorlukIcons[2], 64, 64, WHITE);
  }

  if(y == 1){
    display.drawBitmap(0, 0, zorlukIcons[0], 64, 64, WHITE);
    display.drawBitmap(0, 64, zorlukIcons[3], 64, 64, WHITE);
  }

  display.display();
  display.clearDisplay();
}

void baslangicEkrani(){

  display.drawBitmap(0, 96, baslangicIcons[4], 64, 32, WHITE); // alt tasarim
  display.drawBitmap(0, 0, baslangicIcons[5], 64, 32, WHITE);  // ust tasarim

  if(y == 0){
    display.drawBitmap(0, 32, baslangicIcons[3], 64, 32, WHITE);
    display.drawBitmap(0, 64, baslangicIcons[0], 64, 32, WHITE);
  }

  if(y == 1){
    display.drawBitmap(0, 32, baslangicIcons[2], 64, 32, WHITE);
    display.drawBitmap(0, 64, baslangicIcons[1], 64, 32, WHITE);
  }

  display.display();
  display.clearDisplay();
}

void showScore(int rakam, int basamak){ // birler ise 0, onlar ise 1, yuzler ise 2 (8 ile carpmak icin)
	
	if(rakam == 0){
		pinMode(birler_a + (basamak*8), OUTPUT);
		pinMode(birler_b + (basamak*8), OUTPUT);
		pinMode(birler_c + (basamak*8), OUTPUT);
		pinMode(birler_d + (basamak*8), OUTPUT);
		pinMode(birler_e + (basamak*8), OUTPUT);
		pinMode(birler_f + (basamak*8), OUTPUT);
		pinMode(birler_g + (basamak*8), INPUT);
	}

	if(rakam == 1){
		pinMode(birler_a + (basamak*8), INPUT);
		pinMode(birler_b + (basamak*8), OUTPUT);
		pinMode(birler_c + (basamak*8), OUTPUT);
		pinMode(birler_d + (basamak*8), INPUT);
		pinMode(birler_e + (basamak*8), INPUT);
		pinMode(birler_f + (basamak*8), INPUT);
		pinMode(birler_g + (basamak*8), INPUT);
	}

	if(rakam == 2){
		pinMode(birler_a + (basamak*8), OUTPUT);
		pinMode(birler_b + (basamak*8), OUTPUT);
		pinMode(birler_c + (basamak*8), INPUT);
		pinMode(birler_d + (basamak*8), OUTPUT);
		pinMode(birler_e + (basamak*8), OUTPUT);
		pinMode(birler_f + (basamak*8), INPUT);
		pinMode(birler_g + (basamak*8), OUTPUT);
	}

	if(rakam == 3){
		pinMode(birler_a + (basamak*8), OUTPUT);
		pinMode(birler_b + (basamak*8), OUTPUT);
		pinMode(birler_c + (basamak*8), OUTPUT);
		pinMode(birler_d + (basamak*8), OUTPUT);
		pinMode(birler_e + (basamak*8), INPUT);
		pinMode(birler_f + (basamak*8), INPUT);
		pinMode(birler_g + (basamak*8), OUTPUT);
	}

	if(rakam == 4){
		pinMode(birler_a + (basamak*8), INPUT);
		pinMode(birler_b + (basamak*8), OUTPUT);
		pinMode(birler_c + (basamak*8), OUTPUT);
		pinMode(birler_d + (basamak*8), INPUT);
		pinMode(birler_e + (basamak*8), INPUT);
		pinMode(birler_f + (basamak*8), OUTPUT);
		pinMode(birler_g + (basamak*8), OUTPUT);
	}

	if(rakam == 5){
		pinMode(birler_a + (basamak*8), OUTPUT);
		pinMode(birler_b + (basamak*8), INPUT);
		pinMode(birler_c + (basamak*8), OUTPUT);
		pinMode(birler_d + (basamak*8), OUTPUT);
		pinMode(birler_e + (basamak*8), INPUT);
		pinMode(birler_f + (basamak*8), OUTPUT);
		pinMode(birler_g + (basamak*8), OUTPUT);
	}

	if(rakam == 6){
		pinMode(birler_a + (basamak*8), OUTPUT);
		pinMode(birler_b + (basamak*8), INPUT);
		pinMode(birler_c + (basamak*8), OUTPUT);
		pinMode(birler_d + (basamak*8), OUTPUT);
		pinMode(birler_e + (basamak*8), OUTPUT);
		pinMode(birler_f + (basamak*8), OUTPUT);
		pinMode(birler_g + (basamak*8), OUTPUT);
	}

	if(rakam == 7){
		pinMode(birler_a + (basamak*8), OUTPUT);
		pinMode(birler_b + (basamak*8), OUTPUT);
		pinMode(birler_c + (basamak*8), OUTPUT);
		pinMode(birler_d + (basamak*8), INPUT);
		pinMode(birler_e + (basamak*8), INPUT);
		pinMode(birler_f + (basamak*8), INPUT);
		pinMode(birler_g + (basamak*8), INPUT);
	}

	if(rakam == 8){
		pinMode(birler_a + (basamak*8), OUTPUT);
		pinMode(birler_b + (basamak*8), OUTPUT);
		pinMode(birler_c + (basamak*8), OUTPUT);
		pinMode(birler_d + (basamak*8), OUTPUT);
		pinMode(birler_e + (basamak*8), OUTPUT);
		pinMode(birler_f + (basamak*8), OUTPUT);
		pinMode(birler_g + (basamak*8), OUTPUT);
	}

	if(rakam == 9){
		pinMode(birler_a + (basamak*8), OUTPUT);
		pinMode(birler_b + (basamak*8), OUTPUT);
		pinMode(birler_c + (basamak*8), OUTPUT);
		pinMode(birler_d + (basamak*8), OUTPUT);
		pinMode(birler_e + (basamak*8), INPUT);
		pinMode(birler_f + (basamak*8), OUTPUT);
		pinMode(birler_g + (basamak*8), OUTPUT);
	}

}


